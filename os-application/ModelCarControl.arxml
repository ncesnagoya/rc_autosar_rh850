AUTOSAR XML (schema 4-0-3)
package /Ecuc
  module config Os: ecuc-def-edition=4.2.0, implementation-config-variant=VARIANT-PRE-COMPILE
    OsInclude: OsIncludeFileName=ModelCarControl.h
    7 x OsAppMode:
      AppMode_ALL
      AppMode_Body
      AppMode_Cont
      AppMode_Ope
      AppMode_Body_Cont
      AppMode_Body_Ope
      AppMode_Cont_Ope
    OsOS: OsStackMonitoring=true, OsUseGetServiceId=true, OsUseParameterAccess=true, OsScalabilityClass=SC1, OsStatus=EXTENDED
      OsHooks: OsErrorHook=true, OsPostTaskHook=false, OsPreTaskHook=false, OsProtectionHook=true, OsShutdownHook=true, OsStartupHook=true
      OsHookStack: OsHookStackSize=512
    OperationManagerTask (OsTask): OsTaskActivation=1U, OsTaskPriority=2, OsTaskStackSize=2048, OsTaskSchedule=FULL
    OperationManagerCycAlarm (OsAlarm): OsAlarmCounterRef=MAIN_HW_COUNTER
      OsAlarmAction
        OsAlarmActivateTask: OsAlarmActivateTaskRef=OperationManagerTask
      OsAlarmAutostart:
        OsAlarmAlarmTime = TICK_FOR_10MS
        OsAlarmCycleTime = TICK_FOR_10MS
        OsAlarmAutostartType = ABSOLUTE
        OsAlarmAppModeRef = AppMode_ALL
        OsAlarmAppModeRef = AppMode_Ope
        OsAlarmAppModeRef = AppMode_Body_Ope
        OsAlarmAppModeRef = AppMode_Cont_Ope
    BodyControlTask (OsTask): OsTaskActivation=1U, OsTaskPriority=2, OsTaskStackSize=2048, OsTaskSchedule=FULL
    BodyControlCycAlarm (OsAlarm): OsAlarmCounterRef=MAIN_HW_COUNTER
      OsAlarmAction
        OsAlarmActivateTask: OsAlarmActivateTaskRef=BodyControlTask
      OsAlarmAutostart:
        OsAlarmAlarmTime = TICK_FOR_10MS*10
        OsAlarmCycleTime = TICK_FOR_10MS*10
        OsAlarmAutostartType = ABSOLUTE
        OsAlarmAppModeRef = AppMode_ALL
        OsAlarmAppModeRef = AppMode_Body
        OsAlarmAppModeRef = AppMode_Body_Cont
        OsAlarmAppModeRef = AppMode_Body_Ope
    BuzzerControlCycAlarm (OsAlarm): OsAlarmCounterRef=MAIN_HW_COUNTER
      OsAlarmAction
        OsAlarmCallback: OsAlarmCallbackName=BuzzerControlCycAlarmCb
      OsAlarmAutostart:
        OsAlarmAlarmTime = TICK_FOR_10MS/80
        OsAlarmCycleTime = TICK_FOR_10MS/80
        OsAlarmAutostartType = ABSOLUTE
        OsAlarmAppModeRef = AppMode_ALL
        OsAlarmAppModeRef = AppMode_Body
        OsAlarmAppModeRef = AppMode_Body_Cont
        OsAlarmAppModeRef = AppMode_Body_Ope
    DriveManagerTask (OsTask): OsTaskActivation=1U, OsTaskPriority=3, OsTaskStackSize=2048, OsTaskSchedule=FULL
    DriveManagerCycAlarm (OsAlarm): OsAlarmCounterRef=MAIN_HW_COUNTER
      OsAlarmAction
        OsAlarmActivateTask: OsAlarmActivateTaskRef=DriveManagerTask
      OsAlarmAutostart:
        OsAlarmAlarmTime = TICK_FOR_10MS*2
        OsAlarmCycleTime = TICK_FOR_10MS*2
        OsAlarmAutostartType = ABSOLUTE
        OsAlarmAppModeRef = AppMode_ALL
        OsAlarmAppModeRef = AppMode_Cont
        OsAlarmAppModeRef = AppMode_Body_Cont
        OsAlarmAppModeRef = AppMode_Cont_Ope
    PowerTrainTask (OsTask): OsTaskActivation=1U, OsTaskPriority=14, OsTaskStackSize=2048, OsTaskSchedule=NON
    PowerTrainCycAlarm (OsAlarm): OsAlarmCounterRef=MAIN_HW_COUNTER
      OsAlarmAction
        OsAlarmActivateTask: OsAlarmActivateTaskRef=PowerTrainTask
      OsAlarmAutostart:
        OsAlarmAlarmTime = TICK_FOR_10MS
        OsAlarmCycleTime = TICK_FOR_10MS
        OsAlarmAutostartType = ABSOLUTE
        OsAlarmAppModeRef = AppMode_ALL
        OsAlarmAppModeRef = AppMode_Cont
        OsAlarmAppModeRef = AppMode_Body_Cont
        OsAlarmAppModeRef = AppMode_Cont_Ope
    LedBlinkerCycAlarm (OsAlarm): OsAlarmCounterRef=MAIN_HW_COUNTER
      OsAlarmAction
        OsAlarmCallback: OsAlarmCallbackName=LedBlinkerCycAlarmCb
      OsAlarmAutostart:
        OsAlarmAlarmTime = TICK_FOR_10MS * 50
        OsAlarmCycleTime = TICK_FOR_10MS * 50
        OsAlarmAutostartType = ABSOLUTE
        OsAlarmAppModeRef = AppMode_ALL
        OsAlarmAppModeRef = AppMode_Body
        OsAlarmAppModeRef = AppMode_Cont
        OsAlarmAppModeRef = AppMode_Ope
        OsAlarmAppModeRef = AppMode_Body_Cont
        OsAlarmAppModeRef = AppMode_Body_Ope
        OsAlarmAppModeRef = AppMode_Cont_Ope
