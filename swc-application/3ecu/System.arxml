AUTOSAR XML (schema 4-0-3)
package /System
  system RcCar: system-version=1.0.0
    system mapping SystemMapping
      data-mappings:
        data-element=DriveManager.RootSwCompositionPrototype.BodyIn.headlamp, system-signal=SystemSignal_BodyIn_headlamp
        data-element=DriveManager.RootSwCompositionPrototype.BodyIn.foglamp, system-signal=SystemSignal_BodyIn_foglamp
        data-element=DriveManager.RootSwCompositionPrototype.BodyIn.hazard, system-signal=SystemSignal_BodyIn_hazard
        data-element=DriveManager.RootSwCompositionPrototype.BodyIn.winker_r, system-signal=SystemSignal_BodyIn_winker_r
        data-element=DriveManager.RootSwCompositionPrototype.BodyIn.winker_l, system-signal=SystemSignal_BodyIn_winker_l
        data-element=DriveManager.RootSwCompositionPrototype.WinkerOut.state, system-signal=SystemSignal_WinkerOut_state
        data-element=DriveManager.RootSwCompositionPrototype.BuzzerOut.state, system-signal=SystemSignal_BuzzerOut_state
        data-element=DriveManager.RootSwCompositionPrototype.LampOut.backlamp, system-signal=SystemSignal_LampOut_backlamp
        data-element=DriveManager.RootSwCompositionPrototype.LampOut.brakelamp, system-signal=SystemSignal_LampOut_brakelamp
        data-element=DriveManager.RootSwCompositionPrototype.LampOut.headlamp, system-signal=SystemSignal_LampOut_headlamp
        data-element=DriveManager.RootSwCompositionPrototype.LampOut.foglamp, system-signal=SystemSignal_LampOut_foglamp
        data-element=DriveManager.RootSwCompositionPrototype.DrivingIn.angle, system-signal=SystemSignal_DrivingIn_angle
        data-element=DriveManager.RootSwCompositionPrototype.DrivingIn.speed, system-signal=SystemSignal_DrivingIn_speed
        data-element=DriveManager.RootSwCompositionPrototype.DrivingIn.steern, system-signal=SystemSignal_DrivingIn_steern
        data-element=DriveManager.RootSwCompositionPrototype.DrivingIn.gain, system-signal=SystemSignal_DrivingIn_gain
        data-element=DriveManager.RootSwCompositionPrototype.DrivingIn.brake, system-signal=SystemSignal_DrivingIn_brake
        data-element=CddBodyControl.RootSwCompositionPrototype.BuzzerIn.state, system-signal=SystemSignal_BuzzerIn_state
        data-element=CddBodyControl.RootSwCompositionPrototype.WinkerIn.state, system-signal=SystemSignal_WinkerIn_state
        data-element=CddBodyControl.RootSwCompositionPrototype.LampIn.headlamp, system-signal=SystemSignal_LampIn_headlamp
        data-element=CddBodyControl.RootSwCompositionPrototype.LampIn.foglamp, system-signal=SystemSignal_LampIn_foglamp
        data-element=CddBodyControl.RootSwCompositionPrototype.LampIn.brakelamp, system-signal=SystemSignal_LampIn_brakelamp
        data-element=CddBodyControl.RootSwCompositionPrototype.LampIn.backlamp, system-signal=SystemSignal_LampIn_backlamp
        data-element=CddRcCar.RootSwCompositionPrototype.VehicleInfoOut.angle, system-signal=SystemSignal_VehicleInfoOut_angle
        data-element=CddRcCar.RootSwCompositionPrototype.VehicleInfoOut.speed, system-signal=SystemSignal_VehicleInfoOut_speed
        data-element=CddRcCar.RootSwCompositionPrototype.VehicleInfoOut.pwm_angle, system-signal=SystemSignal_VehicleInfoOut_pwm_speed
        data-element=CddRcCar.RootSwCompositionPrototype.VehicleInfoOut.pwm_speed, system-signal=SystemSignal_VehicleInfoOut_pwm_angle
        data-element=CddDisplayState.RootSwCompositionPrototype.VehicleInfoIn.angle, system-signal=SystemSignal_VehicleInfoIn_angle
        data-element=CddDisplayState.RootSwCompositionPrototype.VehicleInfoIn.speed, system-signal=SystemSignal_VehicleInfoIn_speed
        data-element=CddDisplayState.RootSwCompositionPrototype.VehicleInfoIn.pwm_angle, system-signal=SystemSignal_VehicleInfoIn_pwm_speed
        data-element=CddDisplayState.RootSwCompositionPrototype.VehicleInfoIn.pwm_speed, system-signal=SystemSignal_VehicleInfoIn_pwm_angle
        data-element=OperationManager.RootSwCompositionPrototype.DrivingOut.brake, system-signal=SystemSignal_DrivingOut_brake
        data-element=OperationManager.RootSwCompositionPrototype.DrivingOut.angle, system-signal=SystemSignal_DrivingOut_angle
        data-element=OperationManager.RootSwCompositionPrototype.DrivingOut.gain, system-signal=SystemSignal_DrivingOut_gain
        data-element=OperationManager.RootSwCompositionPrototype.DrivingOut.speed, system-signal=SystemSignal_DrivingOut_speed
        data-element=OperationManager.RootSwCompositionPrototype.DrivingOut.steern, system-signal=SystemSignal_DrivingOut_steern
        data-element=OperationManager.RootSwCompositionPrototype.BodyOut.foglamp, system-signal=SystemSignal_BodyOut_foglamp
        data-element=OperationManager.RootSwCompositionPrototype.BodyOut.hazard, system-signal=SystemSignal_BodyOut_hazard
        data-element=OperationManager.RootSwCompositionPrototype.BodyOut.headlamp, system-signal=SystemSignal_BodyOut_headlamp
        data-element=OperationManager.RootSwCompositionPrototype.BodyOut.winker_l, system-signal=SystemSignal_BodyOut_winker_l
        data-element=OperationManager.RootSwCompositionPrototype.BodyOut.winker_r, system-signal=SystemSignal_BodyOut_winker_r
      sw-mappings:
        9 x swc to ecu mapping:
          CddRcCarToEcuCMapping: component=RootSwCompositionPrototype.CddRcCar.CddRcCar, ecu-instance=EcuInstance_C
          DriveManagerToEcuCMapping: component=RootSwCompositionPrototype.DriveManager.DriveManager, ecu-instance=EcuInstance_C
          CddControllerToEcuOMapping: component=RootSwCompositionPrototype.CddController.CddController, ecu-instance=EcuInstance_OD
          CddBodyControlToEcuBMapping: component=RootSwCompositionPrototype.CddBodyControl.CddBodyControl, ecu-instance=EcuInstance_B
          CddLedBlinkerToEcuBMapping: component=RootSwCompositionPrototype.CddLedBlinker.CddLedBlinker, ecu-instance=EcuInstance_B
          OperationManagerToEcuOMapping: component=RootSwCompositionPrototype.OperationManager.OperationManager, ecu-instance=EcuInstance_OD
          CddDisplayStateToEcuOMapping: component=RootSwCompositionPrototype.CddDisplayState.CddDisplayState, ecu-instance=EcuInstance_OD
          CddLedBlinkerToEcuOMapping: component=RootSwCompositionPrototype.CddLedBlinker.CddLedBlinker, ecu-instance=EcuInstance_OD
          CddLedBlinkerToEcuCMapping: component=RootSwCompositionPrototype.CddLedBlinker.CddLedBlinker, ecu-instance=EcuInstance_C
    root-software-compositions:
      root sw composition prototype RootSwCompositionPrototype: software-composition=Composition_RcCar
  ecu instance EcuInstance_C: com-configuration-gw-time-base=0.1, com-configuration-rx-time-base=0.1, com-configuration-tx-time-base=0.1, sleep-mode-supported=false, wake-up-over-bus-supported=false
    can communication controller CanCommunicationController: can-controller-attributes=can-controller-configuration={sync-jump-width=1, time-seg-1=1, time-seg-2=1}
  ecu instance EcuInstance_B: com-configuration-gw-time-base=0.1, com-configuration-rx-time-base=0.1, com-configuration-tx-time-base=0.1, sleep-mode-supported=false, wake-up-over-bus-supported=false
    can communication controller CanCommunicationController: can-controller-attributes=can-controller-configuration={sync-jump-width=1, time-seg-1=1, time-seg-2=1}
  ecu instance EcuInstance_OD: com-configuration-gw-time-base=0.1, com-configuration-rx-time-base=0.1, com-configuration-tx-time-base=0.1, sleep-mode-supported=false, wake-up-over-bus-supported=false
    can communication controller CanCommunicationController: can-controller-attributes=can-controller-configuration={sync-jump-width=1, time-seg-1=1, time-seg-2=1}
package /Network/Ecu_B
  pdu ISignalIPdu_WinkerIn: unused-bit-pattern=0
    signal ISignal_WinkerIn_state: 32 bit, data-type-policy=PORT-INTERFACE-DEFINITION
  pdu ISignalIPdu_BuzzerIn: unused-bit-pattern=0
    signal ISignal_BuzzerIn_state: 32 bit, data-type-policy=PORT-INTERFACE-DEFINITION
  pdu ISignalIPdu_LampIn: unused-bit-pattern=0
    signal ISignal_LampIn_backlamp: 32 bit, data-type-policy=PORT-INTERFACE-DEFINITION
    signal ISignal_LampIn_brakelamp: 32 bit, data-type-policy=PORT-INTERFACE-DEFINITION
    signal ISignal_LampIn_headlamp: 32 bit, data-type-policy=PORT-INTERFACE-DEFINITION
    signal ISignal_LampIn_foglamp: 32 bit, data-type-policy=PORT-INTERFACE-DEFINITION
package /Network/Ecu_OD
  pdu ISignalIPdu_VehicleInfoIn: unused-bit-pattern=0
    signal ISignal_VehicleInfoIn_angle: 32 bit, data-type-policy=PORT-INTERFACE-DEFINITION
    signal ISignal_VehicleInfoIn_speed: 32 bit, data-type-policy=PORT-INTERFACE-DEFINITION
    signal ISignal_VehicleInfoIn_pwm_speed: 32 bit, data-type-policy=PORT-INTERFACE-DEFINITION
    signal ISignal_VehicleInfoIn_pwm_angle: 32 bit, data-type-policy=PORT-INTERFACE-DEFINITION
  pdu ISignalIPdu_BodyOut: unused-bit-pattern=0
    signal ISignal_BodyOut_foglamp: 32 bit, data-type-policy=PORT-INTERFACE-DEFINITION
    signal ISignal_BodyOut_hazard: 32 bit, data-type-policy=PORT-INTERFACE-DEFINITION
    signal ISignal_BodyOut_winker_r: 32 bit, data-type-policy=PORT-INTERFACE-DEFINITION
    signal ISignal_BodyOut_winker_l: 32 bit, data-type-policy=PORT-INTERFACE-DEFINITION
    signal ISignal_BodyOut_headlamp: 32 bit, data-type-policy=PORT-INTERFACE-DEFINITION
  pdu ISignalIPdu_DrivingOut: unused-bit-pattern=0
    signal ISignal_DrivingOut_angle: 32 bit, data-type-policy=PORT-INTERFACE-DEFINITION
    signal ISignal_DrivingOut_speed: 32 bit, data-type-policy=PORT-INTERFACE-DEFINITION
    signal ISignal_DrivingOut_steern: 32 bit, data-type-policy=PORT-INTERFACE-DEFINITION
    signal ISignal_DrivingOut_gain: 32 bit, data-type-policy=PORT-INTERFACE-DEFINITION
    signal ISignal_DrivingOut_brake: 32 bit, data-type-policy=PORT-INTERFACE-DEFINITION
package /Network/Ecu_C
  pdu ISignalIPdu_BodyIn: unused-bit-pattern=0
    signal ISignal_BodyIn_foglamp: 32 bit, data-type-policy=PORT-INTERFACE-DEFINITION
    signal ISignal_BodyIn_hazard: 32 bit, data-type-policy=PORT-INTERFACE-DEFINITION
    signal ISignal_BodyIn_winker_r: 32 bit, data-type-policy=PORT-INTERFACE-DEFINITION
    signal ISignal_BodyIn_headlamp: 32 bit, data-type-policy=PORT-INTERFACE-DEFINITION
    signal ISignal_BodyIn_winker_l: 32 bit, data-type-policy=PORT-INTERFACE-DEFINITION
  pdu ISignalIPdu_DrivingIn: unused-bit-pattern=0
    signal ISignal_DrivingIn_angle: 32 bit, data-type-policy=PORT-INTERFACE-DEFINITION
    signal ISignal_DrivingIn_speed: 32 bit, data-type-policy=PORT-INTERFACE-DEFINITION
    signal ISignal_DrivingIn_steern: 32 bit, data-type-policy=PORT-INTERFACE-DEFINITION
    signal ISignal_DrivingIn_gain: 32 bit, data-type-policy=PORT-INTERFACE-DEFINITION
    signal ISignal_DrivingIn_brake: 32 bit, data-type-policy=PORT-INTERFACE-DEFINITION
  pdu ISignalIPdu_VehicleInfoOut: unused-bit-pattern=0
    signal ISignal_VehicleInfoOut_angle: 32 bit, data-type-policy=PORT-INTERFACE-DEFINITION
    signal ISignal_VehicleInfoOut_speed: 32 bit, data-type-policy=PORT-INTERFACE-DEFINITION
    signal ISignal_VehicleInfoOut_pwm_speed: 32 bit, data-type-policy=PORT-INTERFACE-DEFINITION
    signal ISignal_VehicleInfoOut_pwm_angle: 32 bit, data-type-policy=PORT-INTERFACE-DEFINITION
  pdu ISignalIPdu_WinkerOut: unused-bit-pattern=0
    signal ISignal_WinkerOut_state: 32 bit, data-type-policy=PORT-INTERFACE-DEFINITION
  pdu ISignalIPdu_BuzzerOut: unused-bit-pattern=0
    signal ISignal_BuzzerOut_state: 32 bit, data-type-policy=PORT-INTERFACE-DEFINITION
  pdu ISignalIPdu_LampOut: unused-bit-pattern=0
    signal ISignal_LampOut_backlamp: 32 bit, data-type-policy=PORT-INTERFACE-DEFINITION
    signal ISignal_LampOut_brakelamp: 32 bit, data-type-policy=PORT-INTERFACE-DEFINITION
    signal ISignal_LampOut_headlamp: 32 bit, data-type-policy=PORT-INTERFACE-DEFINITION
    signal ISignal_LampOut_foglamp: 32 bit, data-type-policy=PORT-INTERFACE-DEFINITION
