AUTOSAR XML (schema 4-0-3)
package /Ecu_C
  module config Os: ecuc-def-edition=4.2.0, implementation-config-variant=VARIANT-PRE-COMPILE
    MainApp (OsAppMode)
    OsOS: OsStackMonitoring=true, OsStatus=EXTENDED, OsUseGetServiceId=true, OsUseParameterAccess=true, OsScalabilityClass=SC1
      OsHooks: OsErrorHook=true, OsProtectionHook=true, OsPreTaskHook=false, OsPostTaskHook=false, OsStartupHook=true, OsShutdownHook=false
      OsHookStack: OsHookStackSize=1024
      OsOsStack: OsOsStackSize=8192
    4 x OsTask, all with OsTaskActivation=1, OsTaskStackSize=1024, OsTaskSchedule=FULL:
      ECU_C_TASK_10ms: OsTaskPriority=5
      ECU_C_TASK_100ms: OsTaskPriority=5
      ECU_INIT_TASK: OsTaskPriority=15
        OsTaskAutostart: OsTaskAppModeRef=MainApp
      ECU_C_SCHM_TASK: OsTaskPriority=2
    OsInclude: OsIncludeFileName=Can_Target.h
    C2ISR_FOR_CAN_RX0 (OsIsr): OsIsrInterruptPriority=1, OsIsrInterruptNumber=17, OsIsrCategory=CATEGORY_2
    C2ISR_FOR_CAN_TX0 (OsIsr): OsIsrInterruptPriority=1, OsIsrInterruptNumber=18, OsIsrCategory=CATEGORY_2
    3 x OsAlarm, all with OsAlarmCounterRef=MAIN_HW_COUNTER:
      ECU_C_ALARM_10ms
        OsAlarmAction
          OsAlarmActivateTask: OsAlarmActivateTaskRef=ECU_C_TASK_10ms
      ECU_C_ALARM_100ms
        OsAlarmAction
          OsAlarmActivateTask: OsAlarmActivateTaskRef=ECU_C_TASK_100ms
      ECU_C_ALARM_20ms_SCHM
        OsAlarmAction
          OsAlarmActivateTask: OsAlarmActivateTaskRef=ECU_C_SCHM_TASK
  module config Rte: ecuc-def-edition=4.2.0, implementation-config-variant=VARIANT-PRE-COMPILE
    RteGeneration:
      RteCodeVendorId = 65
      RteCalibrationSupport = NONE
      RteDevErrorDetect = true
      RteDevErrorDetectUninit = true
      RteGenerationMode = COMPATIBILITY_MODE
      RteOptimizationMode = MEMORY
      RteValueRangeCheckEnabled = false
      RteVfbTraceEnabled = false
    RteInitializationBehavior: RteInitializationStrategy=RTE_INITIALIZATION_STRATEGY_AT_RTE_START_AND_PARTITION_RESTART, RteSectionInitializationPolicy=VALUE
    3 x RteSwComponentInstance:
      SWCI_CddRcCar: RteSoftwareComponentInstanceRef=CddRcCar
        5 x RteEventToTaskMapping:
          IB_CR_TimingEvent_VehicleInfoReporter_100ms: RteActivationOffset=0.0, RtePositionInTask=1, RteEventRef=VehicleInfoReporter_timingEvent, RteMappedToTaskRef=ECU_C_TASK_100ms, RteUsedOsAlarmRef=ECU_C_ALARM_100ms
          IB_CR_TimingEvent_PowerTrain_10ms: RteActivationOffset=0.0, RtePositionInTask=2, RteEventRef=PowerTrain_timingEvent, RteMappedToTaskRef=ECU_C_TASK_10ms, RteUsedOsAlarmRef=ECU_C_ALARM_10ms
          SetSteerAngle: RteEventRef=AngleSrv_OpSetSteerAngle
          SetDriveSpeed: RteEventRef=SpeedSrv_OpSetDriveSpeed
          SetBrake: RteEventRef=BrakeSrv_OpSetBrake
      SWCI_DriveManager: RteSoftwareComponentInstanceRef=DriveManager
        IB_DM_TimingEvent_DrivingControl_20ms (RteEventToTaskMapping):
          RteActivationOffset = 0.0
          RtePositionInTask = 3
          RteEventRef = DrivingControl_timingEvent
          RteMappedToTaskRef = ECU_C_TASK_10ms
          RteUsedOsAlarmRef = ECU_C_ALARM_10ms
        IB_DM_TimingEvent_BodyControl_10ms (RteEventToTaskMapping):
          RteActivationOffset = 0.0
          RtePositionInTask = 4
          RteEventRef = BodyControl_timingEvent
          RteMappedToTaskRef = ECU_C_TASK_10ms
          RteUsedOsAlarmRef = ECU_C_ALARM_10ms
      SWCI_CddLedBlinker: RteSoftwareComponentInstanceRef=CddLedBlinker
        IB_CBL_TimingEvent_LedBlinker_500ms (RteEventToTaskMapping):
          RteActivationOffset = 0.0
          RtePositionInTask = 5
          RteEventRef = LedBlinker_timingEvent
          RteMappedToTaskRef = ECU_C_TASK_100ms
          RteUsedOsAlarmRef = ECU_C_ALARM_100ms
    RteOsInteraction
      3 x RteUsedOsActivation, all with RteExpectedActivationOffset=0.0:
        RteUsedOsActivation1: RteExpectedTickDuration=0.01, RteActivationOsAlarmRef=ECU_C_ALARM_10ms
        RteUsedOsActivation2: RteExpectedTickDuration=0.02, RteActivationOsAlarmRef=ECU_C_ALARM_20ms_SCHM
        RteUsedOsActivation4: RteExpectedTickDuration=0.1, RteActivationOsAlarmRef=ECU_C_ALARM_100ms
    3 x RteBswModuleInstance:
      RteBswModuleInstance_com: RteBswImplementationRef=bswImplementation0
        3 x RteBswExclusiveAreaImpl, all with RteExclusiveAreaImplMechanism=NONE:
          RteBswExclusiveAreaImpl_exclusiveArea{0..2}: RteBswExclusiveAreaRef=Reentrant_{0..2}
        RteBswEventToTaskMapping_timingEvent1 (RteBswEventToTaskMapping):
          RteBswPositionInTask = 0
          RteBswActivationOffset = 0.02
          RteBswEventRef = TimingEvent_MainFunctionRx
          RteBswMappedToTaskRef = ECU_C_SCHM_TASK
          RteBswUsedOsAlarmRef = ECU_C_ALARM_20ms_SCHM
        RteBswEventToTaskMapping_timingEvent2 (RteBswEventToTaskMapping):
          RteBswPositionInTask = 1
          RteBswActivationOffset = 0.02
          RteBswEventRef = TimingEvent_MainFunctionTx
          RteBswMappedToTaskRef = ECU_C_SCHM_TASK
          RteBswUsedOsAlarmRef = ECU_C_ALARM_20ms_SCHM
      RteBswModuleInstance_can: RteBswImplementationRef=bswImplementation1
        RteBswExclusiveAreaImpl_exclusiveArea3 (RteBswExclusiveAreaImpl): RteExclusiveAreaImplMechanism=NONE, RteBswExclusiveAreaRef=Reentrant
      RteBswModuleInstance_canif: RteBswImplementationRef=bswImplementation2
        RteBswExclusiveAreaImpl_exclusiveArea4 (RteBswExclusiveAreaImpl): RteExclusiveAreaImplMechanism=NONE, RteBswExclusiveAreaRef=Reentrant_0
        RteBswExclusiveAreaImpl_exclusiveArea5 (RteBswExclusiveAreaImpl): RteExclusiveAreaImplMechanism=NONE, RteBswExclusiveAreaRef=Reentrant_1
    RteBswGeneral: RteSchMVersionInfoApi=true, RteUseComShadowSignalApi=false
  module config EcuC: ecuc-def-edition=4.2.0, implementation-config-variant=VARIANT-PRE-COMPILE
    EcucPduCollection: PduIdTypeEnum=UINT16, PduLengthTypeEnum=UINT32
      3 x Pdu, all with PduLength=8:
        Pdu{0..2}
  module config EcuM: ecuc-def-edition=4.2.0, implementation-config-variant=VARIANT-PRE-COMPILE
    EcuMConfiguration0 (EcuMConfiguration)
      EcuMCommonConfiguration0 (EcuMCommonConfiguration)
        EcuMWakeupSource0 (EcuMWakeupSource): EcuMWakeupSourceId=0, EcuMWakeupSourcePolling=false
  module config Com: ecuc-def-edition=4.2.0, implementation-config-variant=VARIANT-PRE-COMPILE
    ComConfig: ComConfigurationId=0
      20 x ComSignal, all with ComSignalEndianness=LITTLE_ENDIAN:
        ComSignal0: ComHandleId=0, ComBitPosition=0, ComBitSize=8, ComSignalType=UINT8, ComTransferProperty=TRIGGERED_ON_CHANGE, ComSystemTemplateSystemSignalRef=iSignalToIPduMapping_WinkerOut_state
        ComSignal1: ComHandleId=1, ComBitPosition=8, ComBitSize=8, ComSignalType=UINT8, ComTransferProperty=TRIGGERED_ON_CHANGE, ComSystemTemplateSystemSignalRef=iSignalToIPduMapping_BuzzerOut_state
        ComSignal2: ComHandleId=2, ComBitPosition=19, ComBitSize=1, ComSignalType=BOOLEAN, ComTransferProperty=TRIGGERED_ON_CHANGE, ComSystemTemplateSystemSignalRef=iSignalToIPduMapping_LampOut_backlamp
        ComSignal3: ComHandleId=3, ComBitPosition=18, ComBitSize=1, ComSignalType=BOOLEAN, ComTransferProperty=TRIGGERED_ON_CHANGE, ComSystemTemplateSystemSignalRef=iSignalToIPduMapping_LampOut_brakelamp
        ComSignal4: ComHandleId=4, ComBitPosition=16, ComBitSize=1, ComSignalType=BOOLEAN, ComTransferProperty=TRIGGERED_ON_CHANGE, ComSystemTemplateSystemSignalRef=iSignalToIPduMapping_LampOut_headlamp
        ComSignal5: ComHandleId=5, ComBitPosition=17, ComBitSize=1, ComSignalType=BOOLEAN, ComTransferProperty=TRIGGERED_ON_CHANGE, ComSystemTemplateSystemSignalRef=iSignalToIPduMapping_LampOut_foglamp
        ComSignal6: ComHandleId=6, ComBitPosition=0, ComBitSize=8, ComSignalType=SINT8, ComSystemTemplateSystemSignalRef=iSignalToIPduMapping_DrivingIn_angle
        ComSignal7: ComHandleId=7, ComBitPosition=8, ComBitSize=8, ComSignalType=SINT8, ComSystemTemplateSystemSignalRef=iSignalToIPduMapping_DrivingIn_speed
        ComSignal8: ComHandleId=8, ComBitPosition=16, ComBitSize=8, ComSignalType=UINT8, ComSystemTemplateSystemSignalRef=iSignalToIPduMapping_DrivingIn_steern
        ComSignal9: ComHandleId=9, ComBitPosition=24, ComBitSize=8, ComSignalType=UINT8, ComSystemTemplateSystemSignalRef=iSignalToIPduMapping_DrivingIn_gain
        ComSignal10: ComHandleId=10, ComBitPosition=32, ComBitSize=1, ComSignalType=BOOLEAN, ComSystemTemplateSystemSignalRef=iSignalToIPduMapping_DrivingIn_brake
        ComSignal11: ComHandleId=11, ComBitPosition=33, ComBitSize=1, ComSignalType=BOOLEAN, ComSystemTemplateSystemSignalRef=iSignalToIPduMapping_BodyIn_headlamp
        ComSignal12: ComHandleId=12, ComBitPosition=34, ComBitSize=1, ComSignalType=BOOLEAN, ComSystemTemplateSystemSignalRef=iSignalToIPduMapping_BodyIn_foglamp
        ComSignal13: ComHandleId=13, ComBitPosition=35, ComBitSize=1, ComSignalType=BOOLEAN, ComSystemTemplateSystemSignalRef=iSignalToIPduMapping_BodyIn_hazard
        ComSignal14: ComHandleId=14, ComBitPosition=36, ComBitSize=1, ComSignalType=BOOLEAN, ComSystemTemplateSystemSignalRef=iSignalToIPduMapping_BodyIn_winker_r
        ComSignal15: ComHandleId=15, ComBitPosition=37, ComBitSize=1, ComSignalType=BOOLEAN, ComSystemTemplateSystemSignalRef=iSignalToIPduMapping_BodyIn_winker_l
        ComSignal16: ComHandleId=16, ComBitPosition=0, ComBitSize=8, ComSignalType=SINT8, ComTransferProperty=TRIGGERED_ON_CHANGE, ComSystemTemplateSystemSignalRef=iSignalToIPduMapping_VehicleInfoOut_angle
        ComSignal17: ComHandleId=17, ComBitPosition=8, ComBitSize=8, ComSignalType=SINT8, ComTransferProperty=TRIGGERED_ON_CHANGE, ComSystemTemplateSystemSignalRef=iSignalToIPduMapping_VehicleInfoOut_speed
        ComSignal18: ComHandleId=18, ComBitPosition=16, ComBitSize=16, ComSignalType=UINT16, ComTransferProperty=TRIGGERED_ON_CHANGE, ComSystemTemplateSystemSignalRef=iSignalToIPduMapping_VehicleInfoOut_pwm_angle
        ComSignal19: ComHandleId=19, ComBitPosition=32, ComBitSize=16, ComSignalType=UINT16, ComTransferProperty=TRIGGERED_ON_CHANGE, ComSystemTemplateSystemSignalRef=iSignalToIPduMapping_VehicleInfoOut_pwm_speed
      3 x ComIPdu, all with ComIPduSignalProcessing=IMMEDIATE, ComIPduType=NORMAL, ComIPduGroupRef=ComIPduGroup0:
        ComIPdu0: ComIPduHandleId=0, ComIPduDirection=SEND, ComIPduSignalRef=ComSignal0, ComIPduSignalRef=ComSignal1, ComIPduSignalRef=ComSignal2, ComIPduSignalRef=ComSignal3, ComIPduSignalRef=ComSignal4, ComIPduSignalRef=ComSignal5, ComPduIdRef=Pdu0
          ComTxIPdu: ComTxIPduUnusedAreasDefault=0
            ComTxModeTrue
              ComTxMode: ComTxModeTimeOffset=0.02, ComTxModeTimePeriod=0.02, ComTxModeMode=PERIODIC
        ComIPdu1: ComIPduHandleId=1, ComIPduDirection=RECEIVE, ComIPduSignalRef=ComSignal6, ComIPduSignalRef=ComSignal7, ComIPduSignalRef=ComSignal8, ComIPduSignalRef=ComSignal9, ComIPduSignalRef=ComSignal10, ComIPduSignalRef=ComSignal11, ComIPduSignalRef=ComSignal12, ComIPduSignalRef=ComSignal13, ComIPduSignalRef=ComSignal14, ComIPduSignalRef=ComSignal15, ComPduIdRef=Pdu1
        ComIPdu2: ComIPduHandleId=2, ComIPduDirection=SEND, ComIPduSignalRef=ComSignal16, ComIPduSignalRef=ComSignal17, ComIPduSignalRef=ComSignal18, ComIPduSignalRef=ComSignal19, ComPduIdRef=Pdu2
          ComTxIPdu: ComTxIPduUnusedAreasDefault=0
            ComTxModeTrue
              ComTxMode: ComTxModeMode=DIRECT
      ComIPduGroup0 (ComIPduGroup): ComIPduGroupHandleId=0
      ComTimeBase: ComGwTimeBase=0.02, ComRxTimeBase=0.02, ComTxTimeBase=0.02
    ComGeneral: ComSupportedIPduGroups=1, ComVersionInfoApi=false, ComConfigurationUseDet=true
  module config PduR: ecuc-def-edition=4.2.0, implementation-config-variant=VARIANT-PRE-COMPILE
    PduRGeneral: PduRZeroCostOperation=true, PduRDevErrorDetect=false, PduRVersionInfoApi=false
    PduRRoutingTables: PduRConfigurationId=0
      PduRRoutingTable: PduRIsMinimumRouting=false
        3 x PduRRoutingPath:
          PduRRoutingPath_0
            PduRSrcPdu0 (PduRSrcPdu): PduRSourcePduHandleId=0, PduRSrcPduRef=Pdu0
            PduRDestPdu10 (PduRDestPdu): PduRDestPduHandleId=0, PduRDestPduRef=Pdu0
          PduRRoutingPath_1
            PduRSrcPdu1 (PduRSrcPdu): PduRSourcePduHandleId=1, PduRSrcPduRef=Pdu1
            PduRDestPdu1 (PduRDestPdu): PduRDestPduRef=Pdu1
          PduRRoutingPath_2
            PduRSrcPdu2 (PduRSrcPdu): PduRSourcePduHandleId=2, PduRSrcPduRef=Pdu2
            PduRDestPdu2 (PduRDestPdu): PduRDestPduHandleId=2, PduRDestPduRef=Pdu2
  module config CanIf: ecuc-def-edition=4.2.0, implementation-config-variant=VARIANT-PRE-COMPILE
    CanIfPublicCfg:
      CanIfPublicNumberOfCanHwUnits = 1
      CanIfPublicCancelTransmitSupport = true
      CanIfPublicChangeBaudrateSupport = true
      CanIfPublicDevErrorDetect = true
      CanIfPublicHandleTypeEnum = UINT8
      CanIfPublicMultipleDrvSupport = false
      CanIfPublicPnSupport = false
      CanIfPublicReadRxPduDataApi = true
      CanIfPublicReadRxPduNotifyStatusApi = true
      CanIfPublicReadTxPduNotifyStatusApi = true
      CanIfPublicSetDynamicTxIdApi = false
      CanIfPublicTxBuffering = false
      CanIfPublicTxConfirmPollingSupport = true
      CanIfPublicVersionInfoApi = false
      CanIfPublicWakeupCheckValidSupport = true
    CanIfPrivateCfg: CanIfPrivateDlcCheck=true, CanIfSupportTTCAN=false
    CanIfDispatchCfg:
      CanIfDispatchUserCtrlBusOffName = CanSM_ControllerBusOff
      CanIfDispatchUserCtrlBusOffUL = CAN_SM
      CanIfDispatchUserCtrlModeIndicationName = CanSM_ControllerModeIndication
      CanIfDispatchUserCtrlModeIndicationUL = CAN_SM
      CanIfDispatchUserValidateWakeupEventName = EcuM_ValidateWakeupEvent
      CanIfDispatchUserValidateWakeupEventUL = ECUM
    CanIfCtrlDrvCfg: CanIfCtrlDrvTxCancellation=false, CanIfCtrlDrvInitHohConfigRef=CanIfInitHohCfg, CanIfCtrlDrvNameRef=CanGeneral
      CanIfCtrlCfg0 (CanIfCtrlCfg): CanIfCtrlId=0, CanIfCtrlWakeupSupport=true, CanIfCtrlCanCtrlRef=CanController0
    CanIfInitCfg: CanIfInitCfgSet=main_canif_config
      CanIfBufferCfg0 (CanIfBufferCfg): CanIfBufferSize=0, CanIfBufferHthRef=CanIfHthCfg0
      CanIfBufferCfg1 (CanIfBufferCfg): CanIfBufferSize=0, CanIfBufferHthRef=CanIfHthCfg1
      CanIfInitHohCfg: CanIfInitRefCfgSet=CanConfigSet0
        CanIfHthCfg0 (CanIfHthCfg): CanIfHthCanCtrlIdRef=CanIfCtrlCfg0, CanIfHthIdSymRef=CanHardwareObject0
        CanIfHrhCfg0 (CanIfHrhCfg): CanIfHrhSoftwareFilter=false, CanIfHrhCanCtrlIdRef=CanIfCtrlCfg0, CanIfHrhIdSymRef=CanHardwareObject1
        CanIfHthCfg1 (CanIfHthCfg): CanIfHthCanCtrlIdRef=CanIfCtrlCfg0, CanIfHthIdSymRef=CanHardwareObject2
      CanIfTxPduCfg0 (CanIfTxPduCfg):
        CanIfTxPduCanId = 288
        CanIfTxPduDlc = 8
        CanIfTxPduId = 0
        CanIfTxPduCanIdType = STANDARD_CAN
        CanIfTxPduPnFilterPdu = false
        CanIfTxPduReadNotifyStatus = true
        CanIfTxPduType = STATIC
        CanIfTxPduUserTxConfirmationName = PduR_CanIfTxConfirmation
        CanIfTxPduUserTxConfirmationUL = PDUR
        CanIfTxPduBufferRef = CanIfBufferCfg0
        CanIfTxPduRef = Pdu0
      CanIfRxPduCfg0 (CanIfRxPduCfg):
        CanIfRxPduCanId = 784
        CanIfRxPduDlc = 8
        CanIfRxPduId = 1
        CanIfRxPduCanIdType = STANDARD_CAN
        CanIfRxPduReadData = false
        CanIfRxPduReadNotifyStatus = true
        CanIfRxPduUserRxIndicationName = PduR_CanIfRxIndication
        CanIfRxPduUserRxIndicationUL = PDUR
        CanIfRxPduHrhIdRef = CanIfHrhCfg0
        CanIfRxPduRef = Pdu1
      CanIfTxPduCfg1 (CanIfTxPduCfg):
        CanIfTxPduCanId = 304
        CanIfTxPduDlc = 8
        CanIfTxPduId = 2
        CanIfTxPduCanIdType = STANDARD_CAN
        CanIfTxPduPnFilterPdu = false
        CanIfTxPduReadNotifyStatus = true
        CanIfTxPduType = STATIC
        CanIfTxPduUserTxConfirmationName = PduR_CanIfTxConfirmation
        CanIfTxPduUserTxConfirmationUL = PDUR
        CanIfTxPduBufferRef = CanIfBufferCfg1
        CanIfTxPduRef = Pdu2
  module config Can: ecuc-def-edition=4.2.0, implementation-config-variant=VARIANT-PRE-COMPILE
    CanConfigSet0 (CanConfigSet)
      3 x CanHardwareObject, all with CanHandleType=FULL, CanIdType=STANDARD, CanControllerRef=CanController0:
        CanHardwareObject0: CanObjectId=0, CanIdValue=288, CanObjectType=TRANSMIT
        CanHardwareObject1: CanObjectId=1, CanIdValue=784, CanObjectType=RECEIVE
        CanHardwareObject2: CanObjectId=2, CanIdValue=304, CanObjectType=TRANSMIT
      CanController0 (CanController):
        CanControllerId = 0
        CanControllerBaseAddress = 0
        CanBusoffProcessing = INTERRUPT
        CanControllerActivation = false
        CanRxProcessing = INTERRUPT
        CanTxProcessing = INTERRUPT
        CanWakeupProcessing = INTERRUPT
        CanWakeupSupport = false
        CanWakeupSourceRef = EcuMWakeupSource0
        CanControllerDefaultBaudrate = CanControllerBaudrateConfig_0
        CanControllerBaudrateConfig_0 (CanControllerBaudrateConfig): CanControllerBaudRate=500, CanControllerPropSeg=0, CanControllerSeg1=0, CanControllerSeg2=255, CanControllerSyncJumpWidth=0
        CanControllerBaudrateConfig_1 (CanControllerBaudrateConfig): CanControllerBaudRate=250, CanControllerPropSeg=0, CanControllerSeg1=0, CanControllerSeg2=255, CanControllerSyncJumpWidth=0
    CanGeneral:
      CanIndex = 0
      CanMainFunctionModePeriod = 0.2
      CanTimeoutDuration = 0.1
      CanChangeBaudrateApi = true
      CanDevErrorDetection = true
      CanHardwareCancellation = false
      CanIdenticalIdCancellation = false
      CanMultiplexedTransmission = false
      CanVersionInfoApi = true
      CanCounterRef = MAIN_HW_COUNTER
      CanMainFunctionRWPeriods: CanMainFunctionReadPeriod=0.1
package /EcucValueCollection
  ecuc value collection EcucValueCollection: ecu-extract=RcCar, ecuc-values=[Os, Rte, EcuC, EcuM, Com, PduR, CanIf, Can]
