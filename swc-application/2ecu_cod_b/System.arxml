AUTOSAR XML (schema 4-0-3)
package /System
  system RcCar: system-version=1.0.0
    system mapping SystemMapping
      data-mappings:
        data-element=DriveManager.RootSwCompositionPrototype.WinkerOut.state, system-signal=SystemSignal_WinkerOut_state
        data-element=DriveManager.RootSwCompositionPrototype.BuzzerOut.state, system-signal=SystemSignal_BuzzerOut_state
        data-element=DriveManager.RootSwCompositionPrototype.LampOut.backlamp, system-signal=SystemSignal_LampOut_backlamp
        data-element=DriveManager.RootSwCompositionPrototype.LampOut.brakelamp, system-signal=SystemSignal_LampOut_brakelamp
        data-element=DriveManager.RootSwCompositionPrototype.LampOut.headlamp, system-signal=SystemSignal_LampOut_headlamp
        data-element=DriveManager.RootSwCompositionPrototype.LampOut.foglamp, system-signal=SystemSignal_LampOut_foglamp
        data-element=CddBodyControl.RootSwCompositionPrototype.BuzzerIn.state, system-signal=SystemSignal_BuzzerIn_state
        data-element=CddBodyControl.RootSwCompositionPrototype.WinkerIn.state, system-signal=SystemSignal_WinkerIn_state
        data-element=CddBodyControl.RootSwCompositionPrototype.LampIn.headlamp, system-signal=SystemSignal_LampIn_headlamp
        data-element=CddBodyControl.RootSwCompositionPrototype.LampIn.foglamp, system-signal=SystemSignal_LampIn_foglamp
        data-element=CddBodyControl.RootSwCompositionPrototype.LampIn.brakelamp, system-signal=SystemSignal_LampIn_brakelamp
        data-element=CddBodyControl.RootSwCompositionPrototype.LampIn.backlamp, system-signal=SystemSignal_LampIn_backlamp
      sw-mappings:
        8 x swc to ecu mapping:
          CddRcCarToEcuCOMapping: component=RootSwCompositionPrototype.CddRcCar.CddRcCar, ecu-instance=EcuInstance_COD
          DriveManagerToEcuCOMapping: component=RootSwCompositionPrototype.DriveManager.DriveManager, ecu-instance=EcuInstance_COD
          CddControllerToEcuCOMapping: component=RootSwCompositionPrototype.CddController.CddController, ecu-instance=EcuInstance_COD
          CddBodyControlToEcuBMapping: component=RootSwCompositionPrototype.CddBodyControl.CddBodyControl, ecu-instance=EcuInstance_B
          CddLedBlinkerToEcuBMapping: component=RootSwCompositionPrototype.CddLedBlinker.CddLedBlinker, ecu-instance=EcuInstance_B
          OperationManagerToEcuCOMapping: component=RootSwCompositionPrototype.OperationManager.OperationManager, ecu-instance=EcuInstance_COD
          CddDisplayStateToEcuCOMapping: component=RootSwCompositionPrototype.CddDisplayState.CddDisplayState, ecu-instance=EcuInstance_COD
          CddLedBlinkerToEcuCOMapping: component=RootSwCompositionPrototype.CddLedBlinker.CddLedBlinker, ecu-instance=EcuInstance_COD
    root-software-compositions:
      root sw composition prototype RootSwCompositionPrototype: software-composition=Composition_RcCar
  ecu instance EcuInstance_B: com-configuration-gw-time-base=0.1, com-configuration-rx-time-base=0.1, com-configuration-tx-time-base=0.1, sleep-mode-supported=false, wake-up-over-bus-supported=false
    can communication controller CanCommunicationController: can-controller-attributes=can-controller-configuration={sync-jump-width=1, time-seg-1=1, time-seg-2=1}
  ecu instance EcuInstance_COD: com-configuration-gw-time-base=0.1, com-configuration-rx-time-base=0.1, com-configuration-tx-time-base=0.1, sleep-mode-supported=false, wake-up-over-bus-supported=false
    can communication controller CanCommunicationController: can-controller-attributes=can-controller-configuration={sync-jump-width=1, time-seg-1=1, time-seg-2=1}
package /Network/Ecu_B
  pdu ISignalIPdu_WinkerIn: unused-bit-pattern=0
    signal ISignal_WinkerIn_state: 32 bit, data-type-policy=PORT-INTERFACE-DEFINITION
  pdu ISignalIPdu_BuzzerIn: unused-bit-pattern=0
    signal ISignal_BuzzerIn_state: 32 bit, data-type-policy=PORT-INTERFACE-DEFINITION
  pdu ISignalIPdu_LampIn: unused-bit-pattern=0
    signal ISignal_LampIn_backlamp: 32 bit, data-type-policy=PORT-INTERFACE-DEFINITION
    signal ISignal_LampIn_brakelamp: 32 bit, data-type-policy=PORT-INTERFACE-DEFINITION
    signal ISignal_LampIn_headlamp: 32 bit, data-type-policy=PORT-INTERFACE-DEFINITION
    signal ISignal_LampIn_foglamp: 32 bit, data-type-policy=PORT-INTERFACE-DEFINITION
package /Network/Ecu_COD
  pdu ISignalIPdu_WinkerOut: unused-bit-pattern=0
    signal ISignal_WinkerOut_state: 32 bit, data-type-policy=PORT-INTERFACE-DEFINITION
  pdu ISignalIPdu_BuzzerOut: unused-bit-pattern=0
    signal ISignal_BuzzerOut_state: 32 bit, data-type-policy=PORT-INTERFACE-DEFINITION
  pdu ISignalIPdu_LampOut: unused-bit-pattern=0
    signal ISignal_LampOut_backlamp: 32 bit, data-type-policy=PORT-INTERFACE-DEFINITION
    signal ISignal_LampOut_brakelamp: 32 bit, data-type-policy=PORT-INTERFACE-DEFINITION
    signal ISignal_LampOut_headlamp: 32 bit, data-type-policy=PORT-INTERFACE-DEFINITION
    signal ISignal_LampOut_foglamp: 32 bit, data-type-policy=PORT-INTERFACE-DEFINITION
