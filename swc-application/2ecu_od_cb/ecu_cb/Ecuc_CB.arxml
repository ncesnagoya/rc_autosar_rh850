AUTOSAR XML (schema 4-0-3)
package /Ecu_CB
  module config Os: ecuc-def-edition=4.2.0, implementation-config-variant=VARIANT-PRE-COMPILE
    MainApp (OsAppMode)
    OsOS: OsStackMonitoring=true, OsStatus=EXTENDED, OsUseGetServiceId=true, OsUseParameterAccess=true, OsScalabilityClass=SC1
      OsHooks: OsErrorHook=true, OsProtectionHook=true, OsPreTaskHook=false, OsPostTaskHook=false, OsStartupHook=true, OsShutdownHook=false
      OsHookStack: OsHookStackSize=1024
      OsOsStack: OsOsStackSize=8192
    5 x OsTask, all with OsTaskActivation=1, OsTaskStackSize=1024, OsTaskSchedule=FULL:
      ECU_CB_TASK_125us: OsTaskPriority=11
      ECU_CB_TASK_10ms: OsTaskPriority=5
      ECU_CB_TASK_100ms: OsTaskPriority=5
      ECU_INIT_TASK: OsTaskPriority=15
        OsTaskAutostart: OsTaskAppModeRef=MainApp
      ECU_CB_SCHM_TASK: OsTaskPriority=2
    OsInclude: OsIncludeFileName=Can_Target.h
    C2ISR_FOR_CAN_RX0 (OsIsr): OsIsrInterruptPriority=1, OsIsrInterruptNumber=17, OsIsrCategory=CATEGORY_2
    C2ISR_FOR_CAN_TX0 (OsIsr): OsIsrInterruptPriority=1, OsIsrInterruptNumber=18, OsIsrCategory=CATEGORY_2
    4 x OsAlarm, all with OsAlarmCounterRef=MAIN_HW_COUNTER:
      ECU_CB_ALARM_125us
        OsAlarmAction
          OsAlarmActivateTask: OsAlarmActivateTaskRef=ECU_CB_TASK_125us
      ECU_CB_ALARM_10ms
        OsAlarmAction
          OsAlarmActivateTask: OsAlarmActivateTaskRef=ECU_CB_TASK_10ms
      ECU_CB_ALARM_100ms
        OsAlarmAction
          OsAlarmActivateTask: OsAlarmActivateTaskRef=ECU_CB_TASK_100ms
      ECU_CB_ALARM_20ms_SCHM
        OsAlarmAction
          OsAlarmActivateTask: OsAlarmActivateTaskRef=ECU_CB_SCHM_TASK
  module config Rte: ecuc-def-edition=4.2.0, implementation-config-variant=VARIANT-PRE-COMPILE
    RteGeneration:
      RteCodeVendorId = 65
      RteCalibrationSupport = NONE
      RteDevErrorDetect = true
      RteDevErrorDetectUninit = true
      RteGenerationMode = COMPATIBILITY_MODE
      RteOptimizationMode = MEMORY
      RteValueRangeCheckEnabled = false
      RteVfbTraceEnabled = false
    RteInitializationBehavior: RteInitializationStrategy=RTE_INITIALIZATION_STRATEGY_AT_RTE_START_AND_PARTITION_RESTART, RteSectionInitializationPolicy=VALUE
    4 x RteSwComponentInstance:
      SWCI_CddRcCar: RteSoftwareComponentInstanceRef=CddRcCar
        5 x RteEventToTaskMapping:
          IB_CR_TimingEvent_VehicleInfoReporter_100ms: RteActivationOffset=0.0, RtePositionInTask=1, RteEventRef=VehicleInfoReporter_timingEvent, RteMappedToTaskRef=ECU_CB_TASK_100ms, RteUsedOsAlarmRef=ECU_CB_ALARM_100ms
          IB_CR_TimingEvent_PowerTrain_10ms: RteActivationOffset=0.0, RtePositionInTask=2, RteEventRef=PowerTrain_timingEvent, RteMappedToTaskRef=ECU_CB_TASK_10ms, RteUsedOsAlarmRef=ECU_CB_ALARM_10ms
          SetSteerAngle: RteEventRef=AngleSrv_OpSetSteerAngle
          SetDriveSpeed: RteEventRef=SpeedSrv_OpSetDriveSpeed
          SetBrake: RteEventRef=BrakeSrv_OpSetBrake
      SWCI_DriveManager: RteSoftwareComponentInstanceRef=DriveManager
        IB_DM_TimingEvent_DrivingControl_20ms (RteEventToTaskMapping):
          RteActivationOffset = 0.0
          RtePositionInTask = 3
          RteEventRef = DrivingControl_timingEvent
          RteMappedToTaskRef = ECU_CB_TASK_10ms
          RteUsedOsAlarmRef = ECU_CB_ALARM_10ms
        IB_DM_TimingEvent_BodyControl_10ms (RteEventToTaskMapping):
          RteActivationOffset = 0.0
          RtePositionInTask = 4
          RteEventRef = BodyControl_timingEvent
          RteMappedToTaskRef = ECU_CB_TASK_10ms
          RteUsedOsAlarmRef = ECU_CB_ALARM_10ms
      SWCI_CddBodyControl: RteSoftwareComponentInstanceRef=CddBodyControl
        3 x RteEventToTaskMapping, all with RteActivationOffset=0.0:
          IB_CBC_TimingEvent_WinkerControl_100ms: RtePositionInTask=5, RteEventRef=WinkerControl_timingEvent, RteMappedToTaskRef=ECU_CB_TASK_100ms, RteUsedOsAlarmRef=ECU_CB_ALARM_100ms
          IB_CBC_TimingEvent_BuzzerControl_125us: RtePositionInTask=6, RteEventRef=BuzzerControl_timingEvent, RteMappedToTaskRef=ECU_CB_TASK_125us, RteUsedOsAlarmRef=ECU_CB_ALARM_125us
          IB_CBC_TimingEvent_LampControl_100ms: RtePositionInTask=7, RteEventRef=LampControl_timingEvent, RteMappedToTaskRef=ECU_CB_TASK_100ms, RteUsedOsAlarmRef=ECU_CB_ALARM_100ms
      SWCI_CddLedBlinker: RteSoftwareComponentInstanceRef=CddLedBlinker
        IB_CBL_TimingEvent_LedBlinker_500ms (RteEventToTaskMapping):
          RteActivationOffset = 0.0
          RtePositionInTask = 8
          RteEventRef = LedBlinker_timingEvent
          RteMappedToTaskRef = ECU_CB_TASK_100ms
          RteUsedOsAlarmRef = ECU_CB_ALARM_100ms
    RteOsInteraction
      4 x RteUsedOsActivation, all with RteExpectedActivationOffset=0.0:
        RteUsedOsActivation_ECU_CB_ALARM_125us: RteExpectedTickDuration=0.000125, RteActivationOsAlarmRef=ECU_CB_ALARM_125us
        RteUsedOsActivation1: RteExpectedTickDuration=0.01, RteActivationOsAlarmRef=ECU_CB_ALARM_10ms
        RteUsedOsActivation2: RteExpectedTickDuration=0.02, RteActivationOsAlarmRef=ECU_CB_ALARM_20ms_SCHM
        RteUsedOsActivation4: RteExpectedTickDuration=0.1, RteActivationOsAlarmRef=ECU_CB_ALARM_100ms
    3 x RteBswModuleInstance:
      RteBswModuleInstance_com: RteBswImplementationRef=bswImplementation0
        3 x RteBswExclusiveAreaImpl, all with RteExclusiveAreaImplMechanism=NONE:
          RteBswExclusiveAreaImpl_exclusiveArea{0..2}: RteBswExclusiveAreaRef=Reentrant_{0..2}
        RteBswEventToTaskMapping_timingEvent1 (RteBswEventToTaskMapping):
          RteBswPositionInTask = 0
          RteBswActivationOffset = 0.02
          RteBswEventRef = TimingEvent_MainFunctionRx
          RteBswMappedToTaskRef = ECU_CB_SCHM_TASK
          RteBswUsedOsAlarmRef = ECU_CB_ALARM_20ms_SCHM
        RteBswEventToTaskMapping_timingEvent2 (RteBswEventToTaskMapping):
          RteBswPositionInTask = 1
          RteBswActivationOffset = 0.02
          RteBswEventRef = TimingEvent_MainFunctionTx
          RteBswMappedToTaskRef = ECU_CB_SCHM_TASK
          RteBswUsedOsAlarmRef = ECU_CB_ALARM_20ms_SCHM
      RteBswModuleInstance_can: RteBswImplementationRef=bswImplementation1
        RteBswExclusiveAreaImpl_exclusiveArea3 (RteBswExclusiveAreaImpl): RteExclusiveAreaImplMechanism=NONE, RteBswExclusiveAreaRef=Reentrant
      RteBswModuleInstance_canif: RteBswImplementationRef=bswImplementation2
        RteBswExclusiveAreaImpl_exclusiveArea4 (RteBswExclusiveAreaImpl): RteExclusiveAreaImplMechanism=NONE, RteBswExclusiveAreaRef=Reentrant_0
        RteBswExclusiveAreaImpl_exclusiveArea5 (RteBswExclusiveAreaImpl): RteExclusiveAreaImplMechanism=NONE, RteBswExclusiveAreaRef=Reentrant_1
    RteBswGeneral: RteSchMVersionInfoApi=true, RteUseComShadowSignalApi=false
  module config EcuC: ecuc-def-edition=4.2.0, implementation-config-variant=VARIANT-PRE-COMPILE
    EcucPduCollection: PduIdTypeEnum=UINT16, PduLengthTypeEnum=UINT32
      Pdu0 (Pdu): PduLength=8
      Pdu1 (Pdu): PduLength=8
  module config EcuM: ecuc-def-edition=4.2.0, implementation-config-variant=VARIANT-PRE-COMPILE
    EcuMConfiguration0 (EcuMConfiguration)
      EcuMCommonConfiguration0 (EcuMCommonConfiguration)
        EcuMWakeupSource0 (EcuMWakeupSource): EcuMWakeupSourceId=0, EcuMWakeupSourcePolling=false
  module config Com: ecuc-def-edition=4.2.0, implementation-config-variant=VARIANT-PRE-COMPILE
    ComConfig: ComConfigurationId=0
      14 x ComSignal, all with ComSignalEndianness=LITTLE_ENDIAN:
        ComSignal0: ComHandleId=0, ComBitPosition=0, ComBitSize=8, ComSignalType=SINT8, ComSystemTemplateSystemSignalRef=iSignalToIPduMapping_DrivingIn_angle
        ComSignal1: ComHandleId=1, ComBitPosition=8, ComBitSize=8, ComSignalType=SINT8, ComSystemTemplateSystemSignalRef=iSignalToIPduMapping_DrivingIn_speed
        ComSignal2: ComHandleId=2, ComBitPosition=16, ComBitSize=8, ComSignalType=UINT8, ComSystemTemplateSystemSignalRef=iSignalToIPduMapping_DrivingIn_steern
        ComSignal3: ComHandleId=3, ComBitPosition=24, ComBitSize=8, ComSignalType=UINT8, ComSystemTemplateSystemSignalRef=iSignalToIPduMapping_DrivingIn_gain
        ComSignal4: ComHandleId=4, ComBitPosition=32, ComBitSize=1, ComSignalType=BOOLEAN, ComSystemTemplateSystemSignalRef=iSignalToIPduMapping_DrivingIn_brake
        ComSignal5: ComHandleId=5, ComBitPosition=33, ComBitSize=1, ComSignalType=BOOLEAN, ComSystemTemplateSystemSignalRef=iSignalToIPduMapping_BodyIn_headlamp
        ComSignal6: ComHandleId=6, ComBitPosition=34, ComBitSize=1, ComSignalType=BOOLEAN, ComSystemTemplateSystemSignalRef=iSignalToIPduMapping_BodyIn_foglamp
        ComSignal7: ComHandleId=7, ComBitPosition=35, ComBitSize=1, ComSignalType=BOOLEAN, ComSystemTemplateSystemSignalRef=iSignalToIPduMapping_BodyIn_hazard
        ComSignal8: ComHandleId=8, ComBitPosition=36, ComBitSize=1, ComSignalType=BOOLEAN, ComSystemTemplateSystemSignalRef=iSignalToIPduMapping_BodyIn_winker_r
        ComSignal9: ComHandleId=9, ComBitPosition=37, ComBitSize=1, ComSignalType=BOOLEAN, ComSystemTemplateSystemSignalRef=iSignalToIPduMapping_BodyIn_winker_l
        ComSignal10: ComHandleId=10, ComBitPosition=0, ComBitSize=8, ComSignalType=SINT8, ComTransferProperty=TRIGGERED_ON_CHANGE, ComSystemTemplateSystemSignalRef=iSignalToIPduMapping_VehicleInfoOut_angle
        ComSignal11: ComHandleId=11, ComBitPosition=8, ComBitSize=8, ComSignalType=SINT8, ComTransferProperty=TRIGGERED_ON_CHANGE, ComSystemTemplateSystemSignalRef=iSignalToIPduMapping_VehicleInfoOut_speed
        ComSignal12: ComHandleId=12, ComBitPosition=16, ComBitSize=16, ComSignalType=UINT16, ComTransferProperty=TRIGGERED_ON_CHANGE, ComSystemTemplateSystemSignalRef=iSignalToIPduMapping_VehicleInfoOut_pwm_angle
        ComSignal13: ComHandleId=13, ComBitPosition=32, ComBitSize=16, ComSignalType=UINT16, ComTransferProperty=TRIGGERED_ON_CHANGE, ComSystemTemplateSystemSignalRef=iSignalToIPduMapping_VehicleInfoOut_pwm_speed
      ComIPdu0 (ComIPdu):
        ComIPduHandleId = 0
        ComIPduDirection = RECEIVE
        ComIPduSignalProcessing = IMMEDIATE
        ComIPduType = NORMAL
        ComIPduGroupRef = ComIPduGroup0
        ComIPduSignalRef = ComSignal{0..9}
        ComPduIdRef = Pdu0
      ComIPdu1 (ComIPdu):
        ComIPduHandleId = 1
        ComIPduDirection = SEND
        ComIPduSignalProcessing = IMMEDIATE
        ComIPduType = NORMAL
        ComIPduGroupRef = ComIPduGroup0
        ComIPduSignalRef = ComSignal{10..13}
        ComPduIdRef = Pdu1
        ComTxIPdu: ComTxIPduUnusedAreasDefault=0
          ComTxModeTrue
            ComTxMode: ComTxModeMode=DIRECT
      ComIPduGroup0 (ComIPduGroup): ComIPduGroupHandleId=0
      ComTimeBase: ComGwTimeBase=0.02, ComRxTimeBase=0.02, ComTxTimeBase=0.02
    ComGeneral: ComSupportedIPduGroups=1, ComVersionInfoApi=false, ComConfigurationUseDet=true
  module config PduR: ecuc-def-edition=4.2.0, implementation-config-variant=VARIANT-PRE-COMPILE
    PduRGeneral: PduRZeroCostOperation=true, PduRDevErrorDetect=false, PduRVersionInfoApi=false
    PduRRoutingTables: PduRConfigurationId=0
      PduRRoutingTable: PduRIsMinimumRouting=false
        PduRRoutingPath_0 (PduRRoutingPath)
          PduRSrcPdu0 (PduRSrcPdu): PduRSourcePduHandleId=0, PduRSrcPduRef=Pdu0
          PduRDestPdu0 (PduRDestPdu): PduRDestPduRef=Pdu0
        PduRRoutingPath_1 (PduRRoutingPath)
          PduRSrcPdu1 (PduRSrcPdu): PduRSourcePduHandleId=1, PduRSrcPduRef=Pdu1
          PduRDestPdu1 (PduRDestPdu): PduRDestPduHandleId=1, PduRDestPduRef=Pdu1
  module config CanIf: ecuc-def-edition=4.2.0, implementation-config-variant=VARIANT-PRE-COMPILE
    CanIfPublicCfg:
      CanIfPublicNumberOfCanHwUnits = 1
      CanIfPublicCancelTransmitSupport = true
      CanIfPublicChangeBaudrateSupport = true
      CanIfPublicDevErrorDetect = true
      CanIfPublicHandleTypeEnum = UINT8
      CanIfPublicMultipleDrvSupport = false
      CanIfPublicPnSupport = false
      CanIfPublicReadRxPduDataApi = true
      CanIfPublicReadRxPduNotifyStatusApi = true
      CanIfPublicReadTxPduNotifyStatusApi = true
      CanIfPublicSetDynamicTxIdApi = false
      CanIfPublicTxBuffering = false
      CanIfPublicTxConfirmPollingSupport = true
      CanIfPublicVersionInfoApi = false
      CanIfPublicWakeupCheckValidSupport = true
    CanIfPrivateCfg: CanIfPrivateDlcCheck=true, CanIfSupportTTCAN=false
    CanIfDispatchCfg:
      CanIfDispatchUserCtrlBusOffName = CanSM_ControllerBusOff
      CanIfDispatchUserCtrlBusOffUL = CAN_SM
      CanIfDispatchUserCtrlModeIndicationName = CanSM_ControllerModeIndication
      CanIfDispatchUserCtrlModeIndicationUL = CAN_SM
      CanIfDispatchUserValidateWakeupEventName = EcuM_ValidateWakeupEvent
      CanIfDispatchUserValidateWakeupEventUL = ECUM
    CanIfCtrlDrvCfg: CanIfCtrlDrvTxCancellation=false, CanIfCtrlDrvInitHohConfigRef=CanIfInitHohCfg, CanIfCtrlDrvNameRef=CanGeneral
      CanIfCtrlCfg0 (CanIfCtrlCfg): CanIfCtrlId=0, CanIfCtrlWakeupSupport=true, CanIfCtrlCanCtrlRef=CanController0
    CanIfInitCfg: CanIfInitCfgSet=main_canif_config
      CanIfBufferCfg0 (CanIfBufferCfg): CanIfBufferSize=0, CanIfBufferHthRef=CanIfHthCfg0
      CanIfInitHohCfg: CanIfInitRefCfgSet=CanConfigSet0
        CanIfHrhCfg0 (CanIfHrhCfg): CanIfHrhSoftwareFilter=false, CanIfHrhCanCtrlIdRef=CanIfCtrlCfg0, CanIfHrhIdSymRef=CanHardwareObject0
        CanIfHthCfg0 (CanIfHthCfg): CanIfHthCanCtrlIdRef=CanIfCtrlCfg0, CanIfHthIdSymRef=CanHardwareObject1
      CanIfRxPduCfg0 (CanIfRxPduCfg):
        CanIfRxPduCanId = 784
        CanIfRxPduDlc = 8
        CanIfRxPduId = 0
        CanIfRxPduCanIdType = STANDARD_CAN
        CanIfRxPduReadData = false
        CanIfRxPduReadNotifyStatus = true
        CanIfRxPduUserRxIndicationName = PduR_CanIfRxIndication
        CanIfRxPduUserRxIndicationUL = PDUR
        CanIfRxPduHrhIdRef = CanIfHrhCfg0
        CanIfRxPduRef = Pdu0
      CanIfTxPduCfg0 (CanIfTxPduCfg):
        CanIfTxPduCanId = 304
        CanIfTxPduDlc = 8
        CanIfTxPduId = 1
        CanIfTxPduCanIdType = STANDARD_CAN
        CanIfTxPduPnFilterPdu = false
        CanIfTxPduReadNotifyStatus = true
        CanIfTxPduType = STATIC
        CanIfTxPduUserTxConfirmationName = PduR_CanIfTxConfirmation
        CanIfTxPduUserTxConfirmationUL = PDUR
        CanIfTxPduBufferRef = CanIfBufferCfg0
        CanIfTxPduRef = Pdu1
  module config Can: ecuc-def-edition=4.2.0, implementation-config-variant=VARIANT-PRE-COMPILE
    CanConfigSet0 (CanConfigSet)
      CanHardwareObject0 (CanHardwareObject): CanObjectId=0, CanIdValue=784, CanHandleType=FULL, CanObjectType=RECEIVE, CanIdType=STANDARD, CanControllerRef=CanController0
      CanHardwareObject1 (CanHardwareObject): CanObjectId=1, CanIdValue=304, CanHandleType=FULL, CanObjectType=TRANSMIT, CanIdType=STANDARD, CanControllerRef=CanController0
      CanController0 (CanController):
        CanControllerId = 0
        CanControllerBaseAddress = 0
        CanBusoffProcessing = INTERRUPT
        CanControllerActivation = false
        CanRxProcessing = INTERRUPT
        CanTxProcessing = INTERRUPT
        CanWakeupProcessing = INTERRUPT
        CanWakeupSupport = false
        CanWakeupSourceRef = EcuMWakeupSource0
        CanControllerDefaultBaudrate = CanControllerBaudrateConfig_0
        CanControllerBaudrateConfig_0 (CanControllerBaudrateConfig): CanControllerBaudRate=500, CanControllerPropSeg=0, CanControllerSeg1=0, CanControllerSeg2=255, CanControllerSyncJumpWidth=0
        CanControllerBaudrateConfig_1 (CanControllerBaudrateConfig): CanControllerBaudRate=250, CanControllerPropSeg=0, CanControllerSeg1=0, CanControllerSeg2=255, CanControllerSyncJumpWidth=0
    CanGeneral:
      CanIndex = 0
      CanMainFunctionModePeriod = 0.2
      CanTimeoutDuration = 0.1
      CanChangeBaudrateApi = true
      CanDevErrorDetection = true
      CanHardwareCancellation = false
      CanIdenticalIdCancellation = false
      CanMultiplexedTransmission = false
      CanVersionInfoApi = true
      CanCounterRef = MAIN_HW_COUNTER
      CanMainFunctionRWPeriods: CanMainFunctionReadPeriod=0.1
package /EcucValueCollection
  ecuc value collection EcucValueCollection: ecu-extract=RcCar, ecuc-values=[Os, Rte, EcuC, EcuM, Com, PduR, CanIf, Can]
