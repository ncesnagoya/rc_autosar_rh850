AUTOSAR XML (schema 4-0-3)
package /BSWScheduler/BswModuleDescriptions
  bsw module description Can: module-id=80, provided-entrys=Can/Dummy
    bsw internal behavior InternalBehavior_0
      exclusive area Reentrant
      bsw schedulable entity Dummy: can-enter-exclusive-area=Reentrant, implemented-entry=Can/Dummy
  bsw module description CanIf: module-id=60, provided-entrys=CanIf/Dummy
    bsw internal behavior InternalBehavior_0
      exclusive area Reentrant_0
      exclusive area Reentrant_1
      bsw schedulable entity Dummy: can-enter-exclusive-area=[InternalBehavior_0/Reentrant_0, InternalBehavior_0/Reentrant_1], implemented-entry=CanIf/Dummy
  bsw module description Com: module-id=50, provided-entrys=[MainFunctionRx, MainFunctionTx]
    bsw internal behavior InternalBehavior_0
      exclusive area Reentrant_0
      exclusive area Reentrant_2
      exclusive area Reentrant_1
      bsw schedulable entity MainFunctionRx: can-enter-exclusive-area=[InternalBehavior_0/Reentrant_0, InternalBehavior_0/Reentrant_1, Reentrant_2], implemented-entry=MainFunctionRx
      bsw schedulable entity MainFunctionTx: can-enter-exclusive-area=[InternalBehavior_0/Reentrant_0, InternalBehavior_0/Reentrant_1, Reentrant_2], implemented-entry=MainFunctionTx
      bsw timing event TimingEvent_MainFunctionRx: starts-on-event=MainFunctionRx, period=0.1
      bsw timing event TimingEvent_MainFunctionTx: starts-on-event=MainFunctionTx, period=0.1
package /BSWScheduler/BswModuleEntries/Can
  bsw module entry Dummy: service-id=0, is-reentrant=false, is-synchronous=true, call-type=SCHEDULED, execution-context=TASK, sw-service-impl-policy=STANDARD
package /BSWScheduler/BswModuleEntries/CanIf
  bsw module entry Dummy: service-id=1, is-reentrant=false, is-synchronous=true, call-type=SCHEDULED, execution-context=TASK, sw-service-impl-policy=STANDARD
package /BSWScheduler/BswModuleEntries/Com
  bsw module entry MainFunctionRx: service-id=24, is-reentrant=false, is-synchronous=true, call-type=SCHEDULED, execution-context=TASK, sw-service-impl-policy=STANDARD
  bsw module entry MainFunctionTx: service-id=25, is-reentrant=false, is-synchronous=true, call-type=SCHEDULED, execution-context=TASK, sw-service-impl-policy=STANDARD
package /BSWScheduler/BswImplementations
  bsw implementation bswImplementation0: programming-language=C, sw-version=1.0.0, vendor-id=20, ar-release-version=1.0.0, behavior=Com/InternalBehavior_0, vendor-api-infix=abc
    code-descriptors:
      code Code: artifact-descriptors=autosar-engineering-object={short-label=Label, category=Category}
    resource consumption resourceConsumption
  bsw implementation bswImplementation1: programming-language=C, sw-version=1.0.0, vendor-id=20, ar-release-version=1.0.0, behavior=Can/InternalBehavior_0, vendor-api-infix=abc
    code-descriptors:
      code Code: artifact-descriptors=autosar-engineering-object={short-label=Label, category=Category}
    resource consumption resourceConsumption
  bsw implementation bswImplementation2: programming-language=C, sw-version=1.0.0, vendor-id=20, ar-release-version=1.0.0, behavior=CanIf/InternalBehavior_0, vendor-api-infix=abc
    code-descriptors:
      code Code: artifact-descriptors=autosar-engineering-object={short-label=Label, category=Category}
    resource consumption resourceConsumption
