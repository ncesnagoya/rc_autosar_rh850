AUTOSAR XML (schema 4-0-3)
package /BSWScheduler
  swc bsw mapping UAE2TIT_Interrupt_Mapping: bsw-behavior=IB_UAE2TIT_INTERRUPT, swc-behavior=IB_CDS
package /BSWScheduler/BswModuleDescriptions
  bsw module description UAE2TIT_Interrupt: module-id=99
    bsw internal behavior IB_UAE2TIT_INTERRUPT
      bsw interrupt entity UAE2TIT_Interrupt: implemented-entry=UAE2TIT_Interrupt, interrupt-category=CAT-2, interrupt-source=UART
package /BSWScheduler/BswInterruptEntries
  bsw module entry UAE2TIT_Interrupt: category=INTERRUPT, service-id=0, is-reentrant=false, is-synchronous=true, call-type=INTERRUPT, execution-context=INTERRUPT-CAT-2, sw-service-impl-policy=STANDARD
