AUTOSAR XML (schema 4-0-3)
package /BSWScheduler
  swc bsw mapping RLIN3x_RX_ISR_Mapping: bsw-behavior=IB_ISR_CONTROLLER, swc-behavior=IB_CC
package /BSWScheduler/BswModuleDescriptions
  bsw module description RLIN3x_RX_ISR: module-id=99, provided-entrys=RLIN3x_RX_ISR
    bsw internal behavior IB_ISR_CONTROLLER
      bsw interrupt entity RLIN3x_RX_ISR: implemented-entry=RLIN3x_RX_ISR, interrupt-category=CAT-2, interrupt-source=UART
package /BSWScheduler/BswInterruptEntries
  bsw module entry RLIN3x_RX_ISR: category=INTERRUPT, service-id=0, is-reentrant=false, is-synchronous=true, call-type=INTERRUPT, execution-context=INTERRUPT-CAT-2, sw-service-impl-policy=STANDARD
