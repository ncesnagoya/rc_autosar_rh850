AUTOSAR XML (schema 4-0-3)
standard types defined: boolean, sint8, uint16, uint8, uint32
package /ImplDataTypes
  12 x impl type, all with category=VALUE:
    IDT_Lamp: base-type=boolean
    IDT_RCB3: base-type=uint32
    IDT_Winker: base-type=uint8
    IDT_Angle: base-type=sint8
    IDT_Switch: base-type=boolean
    IDT_Brake: base-type=boolean
    IDT_Speed: base-type=sint8
    IDT_Adjust: base-type=uint8
    IDT_Buzzer: base-type=uint8
    IDT_Cycle: base-type=uint16
    IDT_PWM: base-type=uint16
    IDT_Disp: base-type=uint32
