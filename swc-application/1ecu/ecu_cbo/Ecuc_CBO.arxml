AUTOSAR XML (schema 4-0-3)
package /Ecu_CBO
  module config Os: ecuc-def-edition=4.2.0, implementation-config-variant=VARIANT-PRE-COMPILE
    MainApp (OsAppMode)
    OsOS: OsStackMonitoring=true, OsStatus=EXTENDED, OsUseGetServiceId=true, OsUseParameterAccess=true, OsScalabilityClass=SC1
      OsHooks: OsErrorHook=true, OsProtectionHook=true, OsPreTaskHook=false, OsPostTaskHook=false, OsStartupHook=true, OsShutdownHook=false
      OsHookStack: OsHookStackSize=1024
      OsOsStack: OsOsStackSize=8192
    4 x OsTask, all with OsTaskActivation=1, OsTaskStackSize=1024, OsTaskSchedule=FULL:
      ECU_CBO_TASK_100ms: OsTaskPriority=1
      ECU_CBO_TASK_10ms: OsTaskPriority=4
      ECU_CBO_TASK_125us: OsTaskPriority=3
      ECU_INIT_TASK: OsTaskPriority=15
        OsTaskAutostart: OsTaskAppModeRef=MainApp
    RLIN3x_RX_ISR (OsIsr): OsIsrInterruptPriority=2, OsIsrInterruptNumber=158, OsIsrCategory=CATEGORY_2
    3 x OsAlarm, all with OsAlarmCounterRef=MAIN_HW_COUNTER:
      ECU_CBO_ALARM_100ms
        OsAlarmAction
          OsAlarmActivateTask: OsAlarmActivateTaskRef=ECU_CBO_TASK_100ms
      ECU_CBO_ALARM_10ms
        OsAlarmAction
          OsAlarmActivateTask: OsAlarmActivateTaskRef=ECU_CBO_TASK_10ms
      ECU_CBO_ALARM_125us
        OsAlarmAction
          OsAlarmActivateTask: OsAlarmActivateTaskRef=ECU_CBO_TASK_125us
  module config Rte: ecuc-def-edition=4.2.0, implementation-config-variant=VARIANT-PRE-COMPILE
    RteGeneration:
      RteCodeVendorId = 65
      RteCalibrationSupport = NONE
      RteDevErrorDetect = true
      RteDevErrorDetectUninit = true
      RteGenerationMode = COMPATIBILITY_MODE
      RteOptimizationMode = MEMORY
      RteValueRangeCheckEnabled = false
      RteVfbTraceEnabled = false
    RteInitializationBehavior: RteInitializationStrategy=RTE_INITIALIZATION_STRATEGY_AT_RTE_START_AND_PARTITION_RESTART, RteSectionInitializationPolicy=VALUE
    6 x RteSwComponentInstance:
      SWCI_CddRcCar: RteSoftwareComponentInstanceRef=CddRcCar
        4 x RteEventToTaskMapping:
          IB_CR_TimingEvent_PowerTrain_10ms: RteActivationOffset=0.0, RtePositionInTask=1, RteEventRef=PowerTrain_timingEvent, RteMappedToTaskRef=ECU_CBO_TASK_10ms, RteUsedOsAlarmRef=ECU_CBO_ALARM_10ms
          SetSteerAngle: RteEventRef=AngleSrv_OpSetSteerAngle
          SetDriveSpeed: RteEventRef=SpeedSrv_OpSetDriveSpeed
          SetBrake: RteEventRef=BrakeSrv_OpSetBrake
      SWCI_DriveManager: RteSoftwareComponentInstanceRef=DriveManager
        IB_DM_TimingEvent_DrivingControl_20ms (RteEventToTaskMapping):
          RteActivationOffset = 0.0
          RtePositionInTask = 2
          RteEventRef = DrivingControl_timingEvent
          RteMappedToTaskRef = ECU_CBO_TASK_10ms
          RteUsedOsAlarmRef = ECU_CBO_ALARM_10ms
        IB_DM_TimingEvent_BodyControl_20ms (RteEventToTaskMapping):
          RteActivationOffset = 0.0
          RtePositionInTask = 3
          RteEventRef = BodyControl_timingEvent
          RteMappedToTaskRef = ECU_CBO_TASK_10ms
          RteUsedOsAlarmRef = ECU_CBO_ALARM_10ms
      SWCI_CddBodyControl: RteSoftwareComponentInstanceRef=CddBodyControl
        3 x RteEventToTaskMapping, all with RteActivationOffset=0.0:
          IB_CBC_TimingEvent_WinkerControl_100ms: RtePositionInTask=6, RteEventRef=WinkerControl_timingEvent, RteMappedToTaskRef=ECU_CBO_TASK_100ms, RteUsedOsAlarmRef=ECU_CBO_ALARM_100ms
          IB_CBC_TimingEvent_BuzzerControl_125us: RtePositionInTask=7, RteEventRef=BuzzerControl_timingEvent, RteMappedToTaskRef=ECU_CBO_TASK_125us, RteUsedOsAlarmRef=ECU_CBO_ALARM_125us
          IB_CBC_TimingEvent_LampControl_100ms: RtePositionInTask=8, RteEventRef=LampControl_timingEvent, RteMappedToTaskRef=ECU_CBO_TASK_100ms, RteUsedOsAlarmRef=ECU_CBO_ALARM_100ms
      SWCI_OperationManager: RteSoftwareComponentInstanceRef=OperationManager
        IB_CM_TimingEvent_OperationControl_20ms (RteEventToTaskMapping):
          RteActivationOffset = 0.0
          RtePositionInTask = 4
          RteEventRef = OperationControl_timingEvent
          RteMappedToTaskRef = ECU_CBO_TASK_10ms
          RteUsedOsAlarmRef = ECU_CBO_ALARM_10ms
      SWCI_CddController: RteSoftwareComponentInstanceRef=CddController
        IB_CC_TimingEvent_MessageParser_10ms (RteEventToTaskMapping):
          RteActivationOffset = 0.0
          RtePositionInTask = 5
          RteEventRef = MessageParser_timingEvent
          RteMappedToTaskRef = ECU_CBO_TASK_10ms
          RteUsedOsAlarmRef = ECU_CBO_ALARM_10ms
        GetRCB3Command (RteEventToTaskMapping): RteEventRef=RCB3CommandSrv_OpGetIfRCB3Command
        SetRCB3CommandGotFlgExclusiveArea (RteExclusiveAreaImplementation): RteExclusiveAreaImplMechanism=OS_INTERRUPT_BLOCKING, RteExclusiveAreaRef=EaRCB3CommandGotFlg
        UartRxExclusiveArea (RteExclusiveAreaImplementation): RteExclusiveAreaImplMechanism=OS_INTERRUPT_BLOCKING, RteExclusiveAreaRef=EaUartRx
      SWCI_CddLedBlinker: RteSoftwareComponentInstanceRef=CddLedBlinker
        IB_CBL_TimingEvent_LedBlinker_500ms (RteEventToTaskMapping):
          RteActivationOffset = 0.0
          RtePositionInTask = 9
          RteEventRef = LedBlinker_timingEvent
          RteMappedToTaskRef = ECU_CBO_TASK_100ms
          RteUsedOsAlarmRef = ECU_CBO_ALARM_100ms
    RteOsInteraction
      3 x RteUsedOsActivation, all with RteExpectedActivationOffset=0.0:
        RteUsedOsActivation1: RteExpectedTickDuration=0.01, RteActivationOsAlarmRef=ECU_CBO_ALARM_10ms
        RteUsedOsActivation2: RteExpectedTickDuration=0.000125, RteActivationOsAlarmRef=ECU_CBO_ALARM_125us
        RteUsedOsActivation3: RteExpectedTickDuration=0.1, RteActivationOsAlarmRef=ECU_CBO_ALARM_100ms
    RteBswGeneral: RteSchMVersionInfoApi=true, RteUseComShadowSignalApi=false
  module config EcuC: ecuc-def-edition=4.2.0, implementation-config-variant=VARIANT-PRE-COMPILE
    EcucPduCollection: PduIdTypeEnum=UINT16, PduLengthTypeEnum=UINT32
      Pdu0 (Pdu): PduLength=8
package /EcucValueCollection
  ecuc value collection EcucValueCollection: ecu-extract=RcCar, ecuc-values=[Os, Rte, EcuC]
