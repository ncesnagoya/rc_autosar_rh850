AUTOSAR XML (schema 4-0-3)
package /System
  system RcCar: system-version=1.0.0
    root-software-compositions:
      root sw composition prototype RootSwCompositionPrototype: software-composition=Composition_RcCar
